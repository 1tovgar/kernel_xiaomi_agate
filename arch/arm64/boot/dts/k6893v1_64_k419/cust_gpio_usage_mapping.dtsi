/*
 * Generated by MTK SP DrvGen Version: 3.5.160809 for MT6893.
 * 2026-07-24 17:45:31
 * Do Not Modify The File.
 * Copyright Mediatek Inc. (c) 2016.
*/

&gpio_usage_mapping {
	GPIO_SIM1_HOT_PLUG = <&pio 43 0>;
	GPIO_SIM2_SCLK = <&pio 45 0>;
	GPIO_SIM2_SRST = <&pio 46 0>;
	GPIO_SIM2_SIO = <&pio 47 0>;
	GPIO_SIM1_SIO = <&pio 48 0>;
	GPIO_SIM1_SRST = <&pio 49 0>;
	GPIO_SIM1_SCLK = <&pio 50 0>;
};
